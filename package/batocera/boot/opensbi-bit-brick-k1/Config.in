## package/batocera/boot/opensbi-bit-brick-k1/Config.in
```kconfig
config BR2_PACKAGE_OPENSBI_BIT_BRICK_K1
    bool "opensbi files for Bit-Brick-K1"
    help
        opensbi files for Bit-Brick-K1
```

## package/batocera/boot/uboot-bit-brick-k1/Config.in
```kconfig
config BR2_PACKAGE_UBOOT_BIT_BRICK_K1
    bool "uboot files for Bit-Brick-K1"
    help
        uboot files for Bit-Brick-K1
```
